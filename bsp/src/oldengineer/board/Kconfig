## bsp/src/oldengineer/board/Kconfig
```kconfig
menu "Hardware Drivers Config"

config SOC_STM32F446RE
    bool
    select SOC_SERIES_STM32F4
    select RT_USING_COMPONENTS_INIT
    select RT_USING_USER_MAIN
    default y

menu "Onboard Peripheral Drivers"

    menuconfig CORE_USING_MONITOR
        bool "Enable software wdg"
        select CORE_USING_BUZZER
        select CORE_USING_RGB_LIGHT
        default n
        if CORE_USING_MONITOR
            config BSP_USING_WDT
                bool "Enable hardware wdg"
                select RT_USING_WDT
                default n
            config MONITOR_NEED_ALARM
                bool "Enable monitor alarm"
                default n
        endif

endmenu

menu "On-chip Peripheral Drivers"

    config BSP_USING_ON_CHIP_FLASH
        bool "Enable On-Chip Flash"
        default n

    config BSP_USING_GPIO
        bool "Enable GPIO"
        select RT_USING_PIN
        default y

    menuconfig BSP_USING_UART
        bool "Enable UART"
        default y
        select RT_USING_SERIAL
        if BSP_USING_UART
            config BSP_USING_UART1
                bool "Enable UART1"
                default y
            if BSP_USING_UART1
                config BSP_UART1_RX_USING_DMA
                    bool "Enable UART1 RX DMA"
                    depends on BSP_USING_UART1 && RT_SERIAL_USING_DMA
                    default n
                config BSP_UART1_TX_USING_DMA
                    bool "Enable UART1 TX DMA"
                    depends on BSP_USING_UART1 && RT_SERIAL_USING_DMA
                    default n
            endif
            
            config BSP_USING_UART2
                bool "Enable UART2"
                default y

            config BSP_USING_UART3
                bool "Enable UART3"
                default y
            if BSP_USING_UART3
                config BSP_UART3_RX_USING_DMA
                    bool "Enable UART3 RX DMA"
                    depends on BSP_USING_UART3 && RT_SERIAL_USING_DMA
                    default n
                config BSP_UART3_TX_USING_DMA
                    bool "Enable UART3 TX DMA"
                    depends on BSP_USING_UART3 && RT_SERIAL_USING_DMA
                    default n
            endif

            config BSP_USING_UART6
                bool "Enable UART6"
                default y
            if BSP_USING_UART6
                config BSP_UART6_RX_USING_DMA
                    bool "Enable UART6 RX DMA"
                    depends on BSP_USING_UART6 && RT_SERIAL_USING_DMA
                    default n
                config BSP_UART6_TX_USING_DMA
                    bool "Enable UART6 TX DMA"
                    depends on BSP_USING_UART6 && RT_SERIAL_USING_DMA
                    default n
            endif
        endif

    menuconfig BSP_USING_PWM
        bool "Enable pwm"
        default n
        select RT_USING_PWM
        if BSP_USING_PWM

        menuconfig BSP_USING_PWM2
            bool "Enable timer2 output pwm"
            default y
            if BSP_USING_PWM2
                config BSP_USING_PWM2_CH1
                    bool "Enable PWM2 channel1 (PA0)"
                    default y
                config BSP_USING_PWM2_CH2
                    bool "Enable PWM2 channel2 (PA1)"
                    default y
                config BSP_USING_PWM2_CH3
                    bool "Enable PWM2 channel3 (PA2)"
                    default y
                config BSP_USING_PWM2_CH4
                    bool "Enable PWM2 channel4 (PA3)"
                    default y
            endif

        endif
            
    menuconfig BSP_USING_SPI
        bool "Enable SPI BUS"
        default n
        select RT_USING_SPI
        if BSP_USING_SPI
            config BSP_USING_SPI1
                bool "Enable SPI1 BUS"
                default y

            config BSP_SPI1_TX_USING_DMA
                bool "Enable SPI1 TX DMA"
                depends on BSP_USING_SPI1
                default n
                
            config BSP_SPI1_RX_USING_DMA
                bool "Enable SPI1 RX DMA"
                depends on BSP_USING_SPI1
                select BSP_SPI1_TX_USING_DMA
                default n
        endif

    
    menuconfig BSP_USING_CAN
        bool "Enable CAN"
        default n
        select RT_USING_CAN
        if BSP_USING_CAN
            config BSP_USING_CAN1
                bool "Enable CAN1"
                default n

            config BSP_USING_CAN2
                bool "Enable CAN2"
                default n

            config RT_CAN_USING_HDR
                bool "Enable CAN RX HDR"
                depends on BSP_USING_CAN &&(BSP_USING_CAN1||BSP_USING_CAN2)
                default n
        endif

    config BSP_USING_DSP
        bool "Enable STM32 DSP Libarary"
        default n
    
    config CORE_USING_MONITOR
        bool "Enable monitor"
        default y
        if CORE_USING_MONITOR
            config BSP_USING_WDT
                bool "Enable Hardware watchdog"
                select RT_USING_WDT
                default y
        endif
endmenu

menu "Board extended module Drivers"

endmenu
 
endmenu
```

## bsp/stm32/PublicLib/KConfig
```kconfig
menu "Choose Public Libraries"

menu "Whether to use the HardWare Libraries"

    menuconfig BSP_USING_BUZZER
        bool "Use the driver of buzzers"
        default y
        if BSP_USING_BUZZER
            config BUZZER_PWM_DEVICE_NAME
                string "the specific pwm device used for buzzer"
                default "pwm2"
            config BUZZER_PWM_CHANNEL
                int "the pwm channel used for buzzer"
                default 4
        endif

    menuconfig BSP_USING_REMOTE_DT7
        bool "Use the driver of DT7 remote"
        default y
        if BSP_USING_REMOTE_DT7
            config REMOTE_UART_DEVICE_NAME
                string "the specific uart device used for remote dt7"
                default "uart3"
        endif

    menuconfig BSP_USING_REMOTE_SBUS
        bool "Use the driver of SBUS remote"
        default y
        if BSP_USING_REMOTE_SBUS
            config REMOTE_UART_DEVICE_NAME
                string "the specific uart device used for remote sbus"
                default "uart3"
        endif

    menuconfig BSP_USING_RGB_LIGHT
        bool "Use the driver of rgb light"
        default n
        if BSP_USING_RGB_LIGHT
            config RLIGHT_PWM_DEVICE_NAME
                string "the specific pwm device used for red light"
                default "pwm5"
            config RLIGHT_PWM_CHANNEL
                int "the pwm channel used for red light"
                default 3
            config GLIGHT_PWM_DEVICE_NAME
                string "the specific pwm device used for green light"
                default "pwm5"
            config GLIGHT_PWM_CHANNEL
                int "the pwm channel used for green light"
                default 2
            config BLIGHT_PWM_DEVICE_NAME
                string "the specific pwm device used for blue light"
                default "pwm5"
            config BLIGHT_PWM_CHANNEL
                int "the pwm channel used for blue light"
                default 1
        endif

    config BSP_USING_OLED
        bool "Use the driver of oled screen"
        default n

    menuconfig BSP_USING_SPI_Master
        bool "Use the driver of SPI Master"
        default n
        if BSP_USING_SPI_Master
            config SPI_MASTER_USE_HSPIN
                int "the spin used for Master"
                default 1
            config USE_STC_SLAVE
                bool "whether using STC_slave"
                default y
            menuconfig NEED_SLAVE_NUM
                int "the number of slaves(1--4)"
                default 3
                
                if NEED_SLAVE_NUM>0
                    config CS_PORT_0
                        string "the CS Port to choose slave_0(A instead of a)"
                        default "E"
                    config CS_PIN_0
                        int "the CS Pin to choose slave_0"
                        default 1
                    config RST_PORT_0
                        string "the RST Port to choose slave_0(A instead of a)"
                        default "F"
                    config RST_PIN_0
                        int "the RST Pin to choose slave_0"
                        default 1
                endif

                if NEED_SLAVE_NUM>1
                    config CS_PORT_1
                        string "the CS Port to choose slave_1"
                        default "E"
                    config CS_PIN_1
                        int "the CS Pin to choose slave_1"
                        default 2
                    config RST_PORT_1
                        string "the RST Port to choose slave_1"
                        default "F"
                    config RST_PIN_1
                        int "the RST Pin to choose slave_1"
                        default 2
                endif

                if NEED_SLAVE_NUM>2
                    config CS_PORT_2
                        string "the CS Port to choose slave_2"
                        default "E"
                    config CS_PIN_2
                        int "the CS Pin to choose slave_2"
                        default 3
                    config RST_PORT_2
                        string "the RST Port to choose slave_2"
                        default "F"
                    config RST_PIN_2
                        int "the RST Pin to choose slave_2"
                        default 3
                endif

                if NEED_SLAVE_NUM>3
                config CS_PORT_3
                    string "the CS Port to choose slave_3"
                    default "E"
                config CS_PIN_3
                    int "the CS Pin to choose slave_3"
                    default 4
                config RST_PORT_3
                    string "the RST Port to choose slave_3"
                    default "F"
                config RST_PIN_3
                    int "the RST Pin to choose slave_3"
                    default 4
                endif
        endif

    menuconfig BSP_USING_SD_MASTER
        bool "Use the driver of SD log module"
        default n
        if BSP_USING_SD_MASTER
        menu "SD hardware settings"
            config SD_MASTER_SPI_BUS
                string "the spi bus (spiX)"
                default "spi1"
            config SD_MASTER_DEV_NAME
                string "the spi dev (spiXN)"
                default "spi10"
            config SD_MASTER_SPI_NSS_PORT
                string "the CS port (ie A)"
                default "A"
            config SD_MASTER_SPI_NSS_PIN
                int "the CS pin (ie 4)"
                default 4
        endmenu
        menu "SD software settings"
            config SD_MASTER_BUFF_SIZE
                int "decide the size of the sd general buffer (must be 4*n)"
                range 256 4096
                default 1024
            menu "config the print function"
                config SD_PRINT_BUFF_SIZE
                    int "decide the size of a print buffer"
                    range 32 256
                    default 64
                config SD_PRINT_BUFF_CNT
                    int "decide the count of print buffers"
                    range 2 16
                    default 8
                endmenu
        endmenu
        endif

endmenu

menu "Whether to use the SoftWare Libraries"

    config BSP_USING_CPU_USAGE
        bool "use the cpu usage test module"
        default y

    config BSP_USING_PID
        bool "use the pid module"
        default y

    config BSP_USING_MOTORLIB
        bool "use the motor module"
        select BSP_USING_PID
        default y

    config BSP_USING_SETPLANNING
        bool "use the set planning module"
        default y

    config BSP_USING_QUEUE
        bool "use the array loop queue module"
        default y

    config BSP_USING_LIST
        bool "use the list module"
        default n

    menuconfig BSP_USING_UTILS
        bool "use the utils module"
        default y
        if BSP_USING_UTILS
        config BSP_UTILS_USING_ARM_MATH
            bool "use arm_math"
            default y
        endif

    menuconfig BSP_USING_DATASERVER
        bool "use the dataserver module"
        select BSP_USING_UTILS
        default y
        if BSP_USING_DATASERVER
            config DATA_MAX_SIZE
                int "is the Dataserver's max size"
                range 4 10240
                default 2048
            config DataServer_Handle_MAX
                int "is the Dataserver's handle max size"
                range 10 200
                default 50
        endif

    menu "Use the filter module(s)"

        config BSP_USING_EXACTSMOOTH
            bool "use the ExactSmooth module"
            default y

        config BSP_USING_PLLFILTER
            bool "use the PLL filter"
            select BSP_USING_UTILS
            default n
			
        config BSP_USING_ACCCLAMP
            bool "use the AccClamp module"
            default y
        config BSP_USING_IIR_FILTER
            bool "use the IIR Filter"
            default y			
    endmenu

    menu "Use the key-menu module(s)"

        config BSP_USING_KEY_CALLBACK
            bool "use the key-set callback module"
            default y   

        config BSP_USING_KEY_MENU
            bool "use the key-set menu module"
            select BSP_USING_KEY_CALLBACK
            default y

    endmenu

endmenu

menu "Monitor Settings"

    choice
        prompt "Select monitor settings"
        default BSP_NOT_USING_MONITOR
        config BSP_USING_MONITOR_GIMBAL
            bool "Use monitor for gimbal"
        config BSP_USING_MONITOR_CHASSIS
            bool "Use monitor for chassis"
        config BSP_NOT_USING_MONITOR
            bool "Do not use monitor"
    endchoice

    if BSP_USING_MONITOR_GIMBAL || BSP_USING_MONITOR_CHASSIS
        config BSP_USING_WDG
            bool "Use hardware watch dog"
            default n
        config BSP_USING_MONITOR
            bool "Use the software watch dog"
            default y
        config BSP_USING_SOFT_RESTE
            bool "Use the software reset"
            default N
        config MONITOR_NEED_ALARM
            bool "Whether the monitor need alarm"
            select BSP_USING_MONITOR
            default n
			
		if MONITOR_NEED_ALARM
			config MONITOR_USING_RGB_LIGHT 
				bool "Enable rgb light"
            select BSP_USING_RGB_LIGHT
				default n
			config MONITOR_USING_BUZZER 
				bool "Enable monitor buzzer"
            select BSP_USING_BUZZER
				default n
            config RTT_SWITCH_PIN_NUM
                int "the switch rtt pin num"
                default 2
            config RTT_SWITCH_PIN_PORT
                string "the switch rtt pin port"
                default A                
		endif
    endif

endmenu

endmenu
```
